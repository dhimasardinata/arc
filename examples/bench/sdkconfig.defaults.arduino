## examples/bench/sdkconfig.defaults.arduino
```kconfig
#
# Arduino-ESP32 integration for the benchmark firmware
#
CONFIG_AUTOSTART_ARDUINO=n
CONFIG_ARDUINO_VARIANT="esp32s3"
CONFIG_ARDUINO_SELECTIVE_COMPILATION=y

#
# Required by Arduino as an ESP-IDF component
#
CONFIG_FREERTOS_HZ=1000
CONFIG_LIBC_NEWLIB=y
CONFIG_COMPILER_DISABLE_DEFAULT_ERRORS=y
```

## examples/count/main/Kconfig.projbuild
```kconfig
menu "Arc Count"

    config ARC_COUNT_OUT
        int "Burst output GPIO"
        range 0 48
        default 4
        help
            Output pin driven by arc::Burst. Jumper this pin to the count input pin.

    config ARC_COUNT_IN
        int "Count input GPIO"
        range 0 48
        default 5
        help
            Input pin measured by arc::Count.

    config ARC_COUNT_STACK
        int "Host stack (bytes)"
        range 2048 16384
        default 4096
        help
            Stack for the logging task on Core 0.

    config ARC_COUNT_SAMPLE_MS
        int "Sample period (ms)"
        range 100 10000
        default 1000
        help
            How often the host task reports the hardware count delta.

    config ARC_COUNT_HALF_US
        int "Half pulse width (us)"
        range 1 1000
        default 5
        help
            High and low half-width used in the repeated RMT burst symbols.

    config ARC_COUNT_FILTER_NS
        int "Glitch filter (ns)"
        range 0 1000000
        default 0
        help
            Ignore pulses shorter than this threshold. Set 0 to disable the filter.

endmenu
```

## examples/esp32s3/bench/sdkconfig.defaults
```kconfig
CONFIG_ESP_MAIN_TASK_STACK_SIZE=8192
CONFIG_FREERTOS_CHECK_STACKOVERFLOW_CANARY=y
```

## examples/esp32s3/bench/sdkconfig.defaults.arduino
```kconfig
#
# Arduino-ESP32 integration for the benchmark firmware
#
CONFIG_AUTOSTART_ARDUINO=n
CONFIG_ARDUINO_VARIANT="esp32s3"
CONFIG_ARDUINO_SELECTIVE_COMPILATION=y
CONFIG_ARDUINO_SELECTIVE_SPI=n
CONFIG_ARDUINO_SELECTIVE_Wire=n
CONFIG_ARDUINO_SELECTIVE_ESP_SR=n
CONFIG_ARDUINO_SELECTIVE_EEPROM=n
CONFIG_ARDUINO_SELECTIVE_Preferences=n
CONFIG_ARDUINO_SELECTIVE_Ticker=n
CONFIG_ARDUINO_SELECTIVE_Update=n
CONFIG_ARDUINO_SELECTIVE_Zigbee=n
CONFIG_ARDUINO_SELECTIVE_FS=n
CONFIG_ARDUINO_SELECTIVE_SD=n
CONFIG_ARDUINO_SELECTIVE_SD_MMC=n
CONFIG_ARDUINO_SELECTIVE_SPIFFS=n
CONFIG_ARDUINO_SELECTIVE_FFat=n
CONFIG_ARDUINO_SELECTIVE_LittleFS=n
CONFIG_ARDUINO_SELECTIVE_Network=n
CONFIG_ARDUINO_SELECTIVE_Ethernet=n
CONFIG_ARDUINO_SELECTIVE_PPP=n
CONFIG_ARDUINO_SELECTIVE_Hash=n
CONFIG_ARDUINO_SELECTIVE_ArduinoOTA=n
CONFIG_ARDUINO_SELECTIVE_AsyncUDP=n
CONFIG_ARDUINO_SELECTIVE_DNSServer=n
CONFIG_ARDUINO_SELECTIVE_ESPmDNS=n
CONFIG_ARDUINO_SELECTIVE_HTTPClient=n
CONFIG_ARDUINO_SELECTIVE_Matter=n
CONFIG_ARDUINO_SELECTIVE_NetBIOS=n
CONFIG_ARDUINO_SELECTIVE_WebServer=n
CONFIG_ARDUINO_SELECTIVE_WiFi=n
CONFIG_ARDUINO_SELECTIVE_NetworkClientSecure=n
CONFIG_ARDUINO_SELECTIVE_WiFiProv=n
CONFIG_ARDUINO_SELECTIVE_BLE=n
CONFIG_ARDUINO_SELECTIVE_BluetoothSerial=n
CONFIG_ARDUINO_SELECTIVE_SimpleBLE=n
CONFIG_ARDUINO_SELECTIVE_RainMaker=n
CONFIG_ARDUINO_SELECTIVE_OpenThread=n
CONFIG_ARDUINO_SELECTIVE_Insights=n

#
# Required by Arduino as an ESP-IDF component
#
CONFIG_FREERTOS_HZ=1000
CONFIG_LIBC_NEWLIB=y
CONFIG_COMPILER_DISABLE_DEFAULT_ERRORS=y
```

## examples/esp32s3/trace/main/Kconfig.projbuild
```kconfig
menu "Arc Trace"

    config ARC_TRACE_OUT
        int "Burst output GPIO"
        range 0 48
        default 4
        help
            Output pin driven by arc::Burst. Jumper this pin to the trace input pin.

    config ARC_TRACE_IN
        int "Trace input GPIO"
        range 0 48
        default 5
        help
            Input pin captured by arc::Trace.

    config ARC_TRACE_STACK
        int "Host stack (bytes)"
        range 2048 16384
        default 4096
        help
            Stack for the logging task on Core 0.

    config ARC_TRACE_SAMPLE_MS
        int "Report period (ms)"
        range 100 10000
        default 1000
        help
            How often the host task sends one frame and reports the captured symbols.

    config ARC_TRACE_HALF_US
        int "Base half pulse width (us)"
        range 1 1000
        default 10
        help
            Base duration used to build the pulse-width pattern.

    config ARC_TRACE_MIN_NS
        int "RX minimum pulse width (ns)"
        range 0 1000000
        default 100
        help
            Pulses shorter than this are ignored as glitches.

    config ARC_TRACE_MAX_NS
        int "RX stop width (ns)"
        range 1000 100000000
        default 200000
        help
            Receiving stops when the line stays at one level longer than this.

endmenu
```

## examples/espnow/main/Kconfig.projbuild
```kconfig
menu "Arc ESP-NOW"

    config ARC_ESPNOW_LED
        int "LED GPIO"
        range 0 48
        default 48
        help
            Dedicated output pin driven by the realtime plane.

    config ARC_ESPNOW_STACK
        int "RT stack (bytes)"
        range 2048 16384
        default 4096
        help
            Stack for the Core 1 realtime task.

    config ARC_ESPNOW_NET_STACK
        int "Radio stack (bytes)"
        range 4096 16384
        default 6144
        help
            Stack for the Core 0 Wi-Fi and ESP-NOW task.

    config ARC_ESPNOW_HALF_US
        int "Half period slow (us)"
        range 1000 1000000
        default 20000
        help
            Slow half period for the waveform.

    config ARC_ESPNOW_FAST_HALF_US
        int "Half period fast (us)"
        range 1000 1000000
        default 5000
        help
            Fast half period pushed by the Core 0 control plane.

    config ARC_ESPNOW_CMD_MS
        int "Control cadence (ms)"
        range 500 60000
        default 5000
        help
            How often Core 0 toggles the command word and wave period.

    config ARC_ESPNOW_CHANNEL
        int "Wi-Fi channel"
        range 1 14
        default 1
        help
            Channel used by the ESP-NOW peer entry.

endmenu
```

## examples/pwm/main/Kconfig.projbuild
```kconfig
menu "Arc PWM"

    config ARC_PWM_LED
        int "PWM GPIO"
        range 0 48
        default 48
        help
            GPIO driven by the LEDC PWM example.

    config ARC_PWM_HZ
        int "PWM frequency (Hz)"
        range 1 1000000
        default 1000
        help
            LEDC output frequency.

    config ARC_PWM_DUTY
        int "PWM duty (permille)"
        range 0 1000
        default 500
        help
            Duty cycle in permille. 500 means 50%.

endmenu
```

## examples/timer/main/Kconfig.projbuild
```kconfig
menu "Arc Timer"

    config ARC_TIMER_LED
        int "Timer GPIO"
        range 0 48
        default 48
        help
            Dedicated output pin toggled by the GPTimer alarm ISR on Core 0.

    config ARC_TIMER_PERIOD_US
        int "Alarm period (us)"
        range 1 10000000
        default 500000
        help
            Alarm period in microseconds at 1 MHz timer resolution.

    config ARC_TIMER_LOG_MS
        int "Log period (ms)"
        range 100 10000
        default 1000
        help
            How often the host task logs the free-running timer count.

    config ARC_TIMER_STACK
        int "Host stack (bytes)"
        range 2048 16384
        default 4096
        help
            Stack for the timer logging task.

endmenu
```

## examples/udp/main/Kconfig.projbuild
```kconfig
menu "Arc UDP"

    config ARC_UDP_LED
        int "LED GPIO"
        range 0 48
        default 48
        help
            Dedicated output pin driven by the realtime plane.

    config ARC_UDP_STACK
        int "RT stack (bytes)"
        range 2048 16384
        default 4096
        help
            Stack for the core 1 realtime task.

    config ARC_UDP_NET_STACK
        int "Net stack (bytes)"
        range 4096 16384
        default 6144
        help
            Stack for the core 0 Wi-Fi and UDP task.

    config ARC_UDP_HALF_US
        int "Half period slow (us)"
        range 1000 1000000
        default 20000
        help
            Slow half period for the waveform.

    config ARC_UDP_FAST_HALF_US
        int "Half period fast (us)"
        range 1000 1000000
        default 5000
        help
            Fast half period pushed by the core 0 control plane.

    config ARC_UDP_CMD_MS
        int "Control cadence (ms)"
        range 500 60000
        default 5000
        help
            How often core 0 toggles the command word and wave period.

    config ARC_UDP_SSID
        string "Wi-Fi SSID"
        default ""
        help
            Station SSID used by the UDP example.

    config ARC_UDP_PASS
        string "Wi-Fi password"
        default ""
        help
            Station password. Leave empty for open networks.

    config ARC_UDP_HOST
        string "UDP host"
        default "192.168.1.2"
        help
            IPv4 address or DNS name that will receive telemetry.

    config ARC_UDP_PORT
        int "UDP port"
        range 1 65535
        default 9000
        help
            Destination port for binary telemetry frames.

endmenu
```

## main/Kconfig.projbuild
```kconfig
menu "Arc"

    config ARC_LED
        int "LED GPIO"
        range 0 48
        default 48
        help
            GPIO used by the demo loop.

    config ARC_SENSE
        int "Sense GPIO"
        range 0 48
        default 0
        help
            GPIO sampled through the dedicated input path.

    config ARC_STACK
        int "RT stack (bytes)"
        range 2048 16384
        default 4096
        help
            Stack for the core 1 static task.

    config ARC_HALF_US
        int "Half period (us)"
        range 1000 1000000
        default 200000
        help
            Half period used by the demo wave.

endmenu
```

## main/sdkconfig.defaults
```kconfig
CONFIG_ARC_LED=48
CONFIG_ARC_SENSE=0
CONFIG_ARC_STACK=4096
CONFIG_ARC_HALF_US=200000
```

## sdkconfig.defaults
```kconfig
CONFIG_COMPILER_OPTIMIZATION_PERF=y
CONFIG_COMPILER_CXX_EXCEPTIONS=n
CONFIG_COMPILER_CXX_RTTI=n

CONFIG_ESPTOOLPY_FLASH_MODE_AUTO_DETECT=n
CONFIG_ESPTOOLPY_FLASHMODE_QIO=y
CONFIG_ESPTOOLPY_FLASHFREQ_80M=y
CONFIG_ESPTOOLPY_FLASHSIZE_16MB=y

CONFIG_PARTITION_TABLE_CUSTOM=y
CONFIG_PARTITION_TABLE_CUSTOM_FILENAME="partitions_16mb.csv"

CONFIG_SPIRAM=y
CONFIG_SPIRAM_BOOT_INIT=y
CONFIG_SPIRAM_IGNORE_NOTFOUND=n
CONFIG_SPIRAM_MODE_OCT=y
CONFIG_SPIRAM_TYPE_ESPPSRAM64=y
CONFIG_SPIRAM_SPEED_80M=y
CONFIG_SPIRAM_USE_CAPS_ALLOC=y
CONFIG_SPIRAM_TRY_ALLOCATE_WIFI_LWIP=y

CONFIG_ESP_DEFAULT_CPU_FREQ_MHZ_240=y
CONFIG_ESP_SYSTEM_PANIC_PRINT_REBOOT=y

CONFIG_FREERTOS_USE_TRACE_FACILITY=n
CONFIG_FREERTOS_USE_STATS_FORMATTING_FUNCTIONS=n
CONFIG_FREERTOS_GENERATE_RUN_TIME_STATS=n
CONFIG_FREERTOS_VTASKLIST_INCLUDE_COREID=n

CONFIG_ESP_TASK_WDT_EN=y
CONFIG_ESP_TASK_WDT_INIT=y
CONFIG_ESP_TASK_WDT_TIMEOUT_S=10
CONFIG_ESP_TASK_WDT_CHECK_IDLE_TASK_CPU0=y
CONFIG_ESP_TASK_WDT_CHECK_IDLE_TASK_CPU1=n

CONFIG_ARC_LED=48
CONFIG_ARC_SENSE=0
CONFIG_ARC_STACK=4096
CONFIG_ARC_HALF_US=200000
```

## sdkconfig.defaults.release
```kconfig
CONFIG_BOOTLOADER_LOG_LEVEL_NONE=y
CONFIG_LOG_DEFAULT_LEVEL_NONE=y
CONFIG_LOG_MAXIMUM_EQUALS_DEFAULT=y
CONFIG_LOG_DYNAMIC_LEVEL_CONTROL=n
CONFIG_LOG_TAG_LEVEL_IMPL_NONE=y

CONFIG_COMPILER_OPTIMIZATION_ASSERTIONS_SILENT=y
CONFIG_COMPILER_OPTIMIZATION_CHECKS_SILENT=y
CONFIG_HAL_ASSERTION_DISABLE=y

CONFIG_ESP_ERR_TO_NAME_LOOKUP=n
CONFIG_ESP_SYSTEM_PANIC_SILENT_REBOOT=y
```
